## boards/shields/cosmotyl_5x6_carbonfet/Kconfig.defconfig
```kconfig
if SHIELD_COSMOTYL_5X6_CARBONFET_LEFT

config ZMK_KEYBOARD_NAME
    default "cosmotyl"

    config ZMK_SPLIT_BLE_ROLE_CENTRAL
        default y

endif # SHIELD_COSMOTYL_5X6_CARBONFET_LEFT

if SHIELD_COSMOTYL_5X6_CARBONFET_LEFT || SHIELD_COSMOTYL_5X6_CARBONFET_RIGHT

config ZMK_SPLIT
    default y

endif # SHIELD_COSMOTYL_5X6_CARBONFET_LEFT || SHIELD_COSMOTYL_5X6_CARBONFET_RIGHT
```

## boards/shields/cosmotyl_5x6_carbonfet/Kconfig.shield
```kconfig
config SHIELD_COSMOTYL_5X6_CARBONFET_LEFT
    def_bool $(shields_list_contains,cosmotyl_5x6_carbonfet_left)

config SHIELD_COSMOTYL_5X6_CARBONFET_RIGHT
    def_bool $(shields_list_contains,cosmotyl_5x6_carbonfet_right)
```
